## conf/layer.conf
```bitbake
BBPATH .= ":${LAYERDIR}"
BBFILES += "${LAYERDIR}/recipes*/*/*.bb \
            ${LAYERDIR}/recipes*/*/*.bbappend"

# Let us add layer-specific bbappends which are only applied when that
# layer is included in our configuration
BBFILES += "${@' '.join('${LAYERDIR}/%s/recipes*/*/*.%s' % (layer, ext) \
               for layer in BBFILE_COLLECTIONS.split() for ext in ['bb', 'bbappend'])}"

BBFILE_COLLECTIONS += "iot-simple"
BBFILE_PRIORITY_iot-simple= "10"
BBFILE_PATTERN_iot-simple = "^${LAYERDIR}/"
```

## conf/machine/beaglebone.conf
```bitbake
#@TYPE: Machine
#@NAME: Beaglebone machine
#@DESCRIPTION: Custom configuration for http://beagleboard.org/bone and http://beagleboard.org/black boards

MACHINE_EXTRA_RRECOMMENDS = " kernel-modules kernel-devicetree"

EXTRA_IMAGEDEPENDS += "u-boot"

DEFAULTTUNE ?= "cortexa8hf-neon"
include conf/machine/include/tune-cortexa8.inc

IMAGE_CLASSES += "sdcard_image-bone"
IMAGE_FSTYPES += "ext4 tar.bz2 bone-sdimg"
EXTRA_IMAGECMD_ext4 += " -L rootfs "

SERIAL_CONSOLE = "115200 ttyS0"

PREFERRED_PROVIDER_virtual/kernel = "linux-beagle"
PREFERRED_VERSION_linux-beagle = "4.1%"

KERNEL_IMAGETYPE = "zImage"
KERNEL_DEVICETREE = "am335x-bone.dtb am335x-boneblack.dtb"
KERNEL_EXTRA_ARGS += "LOADADDR=${UBOOT_ENTRYPOINT}"

SPL_BINARY = "MLO"
UBOOT_SUFFIX = "img"
UBOOT_MACHINE = "am335x_evm_config"
UBOOT_ENTRYPOINT = "0x80008000"
UBOOT_LOADADDRESS = "0x80008000"

MACHINE_FEATURES = "ext2 serial usbgadget usbhost vfat"

IMAGE_BOOT_FILES ?= "u-boot.${UBOOT_SUFFIX} MLO"
```
